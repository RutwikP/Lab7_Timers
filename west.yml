## west.yml
```yaml
manifest:
  remotes:
    - name: ncs
      url-base: https://github.com/nrfconnect
  projects:
    - name: sdk-nrf
      remote: ncs
      path: nrf
      revision: v2.3.0-rc2
      import: true
      clone-depth: 1
  self:
    path: RP_blinky_Lab7_x
```
